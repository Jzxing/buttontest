# file: keytest2.ioc
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Mcu.Family=STM32F3
Mcu.Name=STM32F303V(D-E)Tx
Mcu.Package=LQFP100
NVIC.PriorityGroup=NVIC_PRIORITYGROUP_4
PA13.Mode=Serial_Wire
PA13.Signal=SYS_JTMS-SWDIO
PA14.Mode=Serial_Wire
PA14.Signal=SYS_JTCK-SWCLK
ProjectManager.HeapSize=0x200
ProjectManager.StackSize=0x400
ProjectManager.TargetToolchain=STM32CubeIDE
RCC.AHBFreq_Value=8000000
RCC.APB1Freq_Value=8000000
RCC.APB2Freq_Value=8000000
RCC.CortexFreq_Value=8000000
RCC.HSE_VALUE=8000000
RCC.HSI_VALUE=8000000
RCC.LSE_VALUE=32768
RCC.SYSCLKFreq_VALUE=8000000
RCC.USBFreq_Value=16000000
board=custom

// file: Core/Src/main.c
/* USER CODE BEGIN Header */
/**
  ******************************************************************************
  * @file           : main.c
  * @brief          : Main program body
  ******************************************************************************
  * @attention
  *
  * Copyright (c) 2022 STMicroelectronics.
  * All rights reserved.
  *
  * This software is licensed under terms that can be found in the LICENSE file
  * in the root directory of this software component.
  * If no LICENSE file comes with this software, it is provided AS-IS.
  *
  ******************************************************************************
  */
/* USER CODE END Header */
#include "main.h"

void SystemClock_Config(void);
static void MX_GPIO_Init(void);

int main(void)
{

  /* MCU Configuration--------------------------------------------------------*/

  /* Reset of all peripherals, Initializes the Flash interface and the Systick. */
  HAL_Init();

  /* Configure the system clock */
  SystemClock_Config();

  /* Initialize all configured peripherals */
  MX_GPIO_Init();
  /* USER CODE BEGIN 2 */
  GPIO_InitTypeDef gp;
  gp.Pin = GPIO_PIN_10 | GPIO_PIN_9 | GPIO_PIN_8 | GPIO_PIN_11;
  gp.Mode = GPIO_MODE_OUTPUT_PP;
  gp.Speed = GPIO_SPEED_FREQ_LOW;

  HAL_GPIO_Init(GPIOE, &gp);

  gp.Pin = GPIO_PIN_6;
  gp.Mode = GPIO_MODE_INPUT;//input mode
  gp.Pull = GPIO_NOPULL;//浮空
  __HAL_RCC_GPIOE_CLK_ENABLE();
  HAL_GPIO_Init(GPIOE, &gp);
  HAL_GPIO_WritePin(GPIOE,GPIO_PIN_10 | GPIO_PIN_9 | GPIO_PIN_8 | GPIO_PIN_11, GPIO_PIN_SET);
  //HAL_GPIO_WritePin(GPIOE, GPIO_PIN_8, GPIO_PIN_SET);

  /* USER CODE END 2 */

  /* Infinite loop */
  /* USER CODE BEGIN WHILE */
  //key未按下的情况，为高电平1
  unsigned int index = 0;
  unsigned int keyval = 1;
  unsigned int newkeyval = 1;
  //按照自己的思路来就行了

  while (1)
  {
	  newkeyval = HAL_GPIO_ReadPin(GPIOE, GPIO_PIN_6) == GPIO_PIN_SET ? 1 : 0;
	  if(newkeyval == 0){
		  HAL_Delay(20);
		  while(HAL_GPIO_ReadPin(GPIOE, GPIO_PIN_6) == 0);
		  HAL_Delay(20);
		  switch(index % 3){
		  	  case 0:
		  	  	//HAL_GPIO_TogglePin(GPIOE, GPIO_PIN_8);
		  		HAL_GPIO_WritePin(GPIOE,GPIO_PIN_10 | GPIO_PIN_11, GPIO_PIN_SET);
		  		HAL_GPIO_WritePin(GPIOE, GPIO_PIN_8,  GPIO_PIN_RESET);
		  	  	break;
		  	  case 1:
		  	  	//HAL_GPIO_TogglePin(GPIOE, GPIO_PIN_10);
		  		HAL_GPIO_WritePin(GPIOE,GPIO_PIN_8 | GPIO_PIN_11, GPIO_PIN_SET);
		  		HAL_GPIO_WritePin(GPIOE, GPIO_PIN_10,  GPIO_PIN_RESET);
		  	  	break;
		  	  case 2:
		  	  	//HAL_GPIO_TogglePin(GPIOE, GPIO_PIN_11);
		  		HAL_GPIO_WritePin(GPIOE,GPIO_PIN_10 | GPIO_PIN_8, GPIO_PIN_SET);
		  		HAL_GPIO_WritePin(GPIOE, GPIO_PIN_11,  GPIO_PIN_RESET);
		  	  	break;
		  	  default:
		  	  	break;
		  	  }
		  index++;

	  }
	  HAL_Delay(1);

    /* USER CODE END WHILE */

  }
}

void SystemClock_Config(void)
{
  RCC_OscInitTypeDef RCC_OscInitStruct = {0};
  RCC_ClkInitTypeDef RCC_ClkInitStruct = {0};

  /** Initializes the RCC Oscillators according to the specified parameters
  * in the RCC_OscInitTypeDef structure.
  */
  RCC_OscInitStruct.OscillatorType = RCC_OSCILLATORTYPE_HSI;
  RCC_OscInitStruct.HSIState = RCC_HSI_ON;
  RCC_OscInitStruct.HSICalibrationValue = RCC_HSICALIBRATION_DEFAULT;
  RCC_OscInitStruct.PLL.PLLState = RCC_PLL_NONE;
  if (HAL_RCC_OscConfig(&RCC_OscInitStruct) != HAL_OK)
  {
    Error_Handler();
  }

  /** Initializes the CPU, AHB and APB buses clocks
  */
  RCC_ClkInitStruct.ClockType = RCC_CLOCKTYPE_HCLK|RCC_CLOCKTYPE_SYSCLK
                              |RCC_CLOCKTYPE_PCLK1|RCC_CLOCKTYPE_PCLK2;
  RCC_ClkInitStruct.SYSCLKSource = RCC_SYSCLKSOURCE_HSI;
  RCC_ClkInitStruct.AHBCLKDivider = RCC_SYSCLK_DIV1;
  RCC_ClkInitStruct.APB1CLKDivider = RCC_HCLK_DIV1;
  RCC_ClkInitStruct.APB2CLKDivider = RCC_HCLK_DIV1;

  if (HAL_RCC_ClockConfig(&RCC_ClkInitStruct, FLASH_LATENCY_0) != HAL_OK)
  {
    Error_Handler();
  }
}

static void MX_GPIO_Init(void)
{

  /* GPIO Ports Clock Enable */
  __HAL_RCC_GPIOA_CLK_ENABLE();
  __HAL_RCC_GPIOE_CLK_ENABLE();

}

void Error_Handler(void)
{
  __disable_irq();
  while (1)
  {
  }
}
